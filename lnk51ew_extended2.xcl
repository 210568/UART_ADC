////////////////////////////////////////////////////////////////////////////////
//    lnk51ew_extended2_banked_ext2.xcl: linker command file for IAR Embedded Workbench IDE
////////////////////////////////////////////////////////////////////////////////
//
//  Segment limits
//  ==============
//
//    IDATA
//    -----
-D_IDATA0_START=0x00
-D_IDATA0_END=0xFF
//
//    PDATA
//    -----
-D_PDATA0_START=0x0000
-D_PDATA0_END=0x00FF
//
//    IXDATA
//    ------
-D_IXDATA0_START=0x0001
-D_IXDATA0_END=0x0FFF
//
//    XDATA
//    -----
-D_XDATA0_START=0x0001
-D_XDATA0_END=0x0FFF
//
//    CODE
//    ----
-D_CODE0_START=0x0000
-D_CODE0_END=0xFFFF
//
//  Special SFRs
//  ============
//
//    Register bank setup
//    -------------------
-D?REGISTER_BANK=0x0
-D_REGISTER_BANK_START=0x0
//
//    Virtual register setup
//    ----------------------
-D_BREG_START=0x00
-D?VB=0x20
//
//  Segments coping with code banking setup for the extended 2 core.
//  ================================================================
//
//    BANKED CONSTANT SEGMENTS
//    ------------------------
-Z(CODE)BANKED_CODE_EXT2_C=[0x0F0000-0x0FFFFF]
//
//    SPRINGBOARD SEGMENTS
//    --------------------
-KBANKED_EXT2=10000,15
-Z(CODE)BANKED_EXT2#FFF0-FFFF
//
//    INTERRUPT SEGMENTS
//    ------------------
-Z(CODE)BANKED_CODE_INTERRUPTS_EXT2=[0x00E0100-0x00EFFFF]
-P(CODE)INTVEC_EXT2=[0x0E0000-0x0EFFFF]
//
////////////////////////////////////////////////////////////////////////////////
// Do not edit the section below unless you are very sure of what you do
////////////////////////////////////////////////////////////////////////////////
//
//
//  IDATA memory
//  ============
-Z(BIT)BREG=_BREG_START
-Z(BIT)BIT_N=0-7F
-Z(DATA)REGISTERS+8=_REGISTER_BANK_START
-Z(DATA)BDATA_Z,BDATA_N,BDATA_I=20-2F
-Z(DATA)VREG=08-7F
-Z(DATA)PSP,XSP=08-7F
-Z(DATA)DOVERLAY=08-7F
-Z(DATA)DATA_I,DATA_Z,DATA_N=08-7F
-U(IDATA)0-7F=(DATA)0-7F
-Z(IDATA)IDATA_I,IDATA_Z,IDATA_N=08-_IDATA0_END
-Z(IDATA)ISTACK+_IDATA_STACK_SIZE#08-_IDATA0_END
-Z(IDATA)IOVERLAY=08-FF
//
//  ROM memory
//  ==========
//
//    Top of memory
//    -------------
-Z(CODE)INTVEC=0
-Z(CODE)CSTART=_CODE0_START-_CODE0_END
//
//    Initializers
//    ------------
-Z(CODE)BIT_ID,BDATA_ID,DATA_ID,IDATA_ID,IXDATA_ID,PDATA_ID,XDATA_ID=_CODE0_START-_CODE0_END
-Z(CODE)HUGE_ID=_CODE0_START-_CODE0_END
//
//    Program memory
//    --------------
-Z(CODE)RCODE,DIFUNCT=_CODE0_START-_CODE0_END
-P(CODE)CODE_C,CODE_N,NEAR_CODE=_CODE0_START-_CODE0_END
//
//    Banked code
//    -----------
-P(CODE)BANKED_CODE=[(_CODEBANK_START)-(_CODEBANK_END)]*_NR_OF_BANKS+10000
//
//    Checksum
//    --------
-Z(CODE)CHECKSUM#_CODE0_END
//
//  XDATA memory
//  ============
//
//    PDATA - data memory
//    -------------------
-Z(XDATA)PDATA_Z,PDATA_I=_PDATA0_START-_PDATA0_END
-P(XDATA)PDATA_N=_PDATA0_START-_PDATA0_END
-Z(XDATA)PSTACK+_PDATA_STACK_SIZE=_PDATA0_START-_PDATA0_END
//
//    Stacks located in XDATA
//    -----------------------
-Z(XDATA)EXT_STACK+_EXTENDED_STACK_SIZE=_EXTENDED_STACK_START
-Z(XDATA)XSTACK+_XDATA_STACK_SIZE=_XDATA0_START-_XDATA0_END
//
//    XDATA - data memory
//    -------------------
-Z(XDATA)IXDATA_I,IXDATA_Z=_IXDATA0_START-_IXDATA0_END
-P(XDATA)IXDATA_N=_IXDATA0_START-_IXDATA0_END
-Z(XDATA)XDATA_I,XDATA_Z=_XDATA0_START-_XDATA0_END
-P(XDATA)XDATA_N=_XDATA0_START-_XDATA0_END
-Z(XDATA)XDATA_HEAP+_XDATA_HEAP_SIZE=_XDATA0_START-_XDATA0_END
-Z(CONST)XDATA_ROM_C=_XDATA0_START-_XDATA0_END
//
//  Core
//  ====
-cx51

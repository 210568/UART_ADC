////////////////////////////////////////////////////////////////////////////////
//    lnk51ew_extended1_far.xcl: linker command file for IAR Embedded Workbench IDE
////////////////////////////////////////////////////////////////////////////////
//
//  Segment limits
//  ==============
//
//    IDATA
//    -----
-D_IDATA0_START=0x00
-D_IDATA0_END=0xFF
//
//    PDATA
//    -----
-D_PDATA0_START=0x0000
-D_PDATA0_END=0x00FF
//
//    IXDATA
//    ------
-D_IXDATA0_START=0x0001
-D_IXDATA0_END=0x0FFF
//
//    XDATA
//    -----
-D_XDATA0_START=0x0001
-D_XDATA0_END=0x0FFF
//
//    FAR22 DATA
//    ----------
-D_FAR22_DATA0_START=0x010001
-D_FAR22_DATA0_END=0x3FFFFF
//
//    FAR DATA
//    --------
-D_FAR_DATA0_START=0x010001
-D_FAR_DATA0_END=0x3FFFFF
//
//    CODE
//    ----
-D_CODE0_START=0x0000
-D_CODE0_END=0xFFFF
//
//    FAR22 CODE
//    ----------
-D_FAR22_CODE0_START=0x000000
-D_FAR22_CODE0_END=0x3FFFFF
//
//    FAR CODE
//    --------
-D_FAR_CODE0_START=0x000000
-D_FAR_CODE0_END=0x3FFFFF
//
//  Special SFRs
//  ============
//
//    Register bank setup
//    -------------------
-D?REGISTER_BANK=0x0
-D_REGISTER_BANK_START=0x0
//
//    Virtual register setup
//    ----------------------
-D_BREG_START=0x00
-D?VB=0x20
//
//  Device specific symbol definitions
//  ==================================
-D?ACON=0x9D                  //Address Control Register location
-D?DPS1=0xF6                  //DPTR Control Register location
-D?TA=0xC7                    //Timed Access register location
-D?MCON=0xC6                  //Memory Control register location
//
////////////////////////////////////////////////////////////////////////////////
// Do not edit the section below unless you are very sure of what you do
////////////////////////////////////////////////////////////////////////////////
//
//
//  IDATA memory
//  ============
-Z(BIT)BREG=_BREG_START
-Z(BIT)BIT_N=0-7F
-Z(DATA)REGISTERS+8=_REGISTER_BANK_START
-Z(DATA)BDATA_Z,BDATA_N,BDATA_I=20-2F
-Z(DATA)VREG=08-7F
-Z(DATA)PSP,XSP=08-7F
-Z(DATA)DOVERLAY=08-7F
-Z(DATA)DATA_I,DATA_Z,DATA_N=08-7F
-U(IDATA)0-7F=(DATA)0-7F
-Z(IDATA)IDATA_I,IDATA_Z,IDATA_N=08-_IDATA0_END
-Z(IDATA)ISTACK+_IDATA_STACK_SIZE#08-_IDATA0_END
-Z(IDATA)IOVERLAY=08-FF
//
//  ROM memory
//  ==========
//
//    Top of memory
//    -------------
-Z(CODE)INTVEC=0
-Z(CODE)CSTART=_CODE0_START-_CODE0_END
//
//    Initializers
//    ------------
-Z(CODE)BIT_ID,BDATA_ID,DATA_ID,IDATA_ID,IXDATA_ID,PDATA_ID,XDATA_ID=_CODE0_START-_CODE0_END
-Z(CODE)HUGE_ID=_FAR_CODE0_START-_FAR_CODE0_END
//
//    Program memory
//    --------------
-Z(CODE)RCODE,DIFUNCT=_CODE0_START-_CODE0_END
-P(CODE)CODE_C,CODE_N,NEAR_CODE=_CODE0_START-_CODE0_END
//
//    FAR CODE
//    --------
-P(CODE)FAR22_CODE_C,FAR22_CODE_N=[_FAR22_CODE0_START-_FAR22_CODE0_END]/10000
-P(CODE)FAR_CODE_C,FAR_CODE_N,FAR_CODE=[_FAR_CODE0_START-_FAR_CODE0_END]/10000
-P(CODE)HUGE_CODE_C,HUGE_CODE_N=_FAR_CODE0_START-_FAR_CODE0_END
//
//    Checksum
//    --------
-Z(CODE)CHECKSUM#_CODE0_END
//
//  XDATA memory
//  ============
//
//    PDATA - data memory
//    -------------------
-Z(XDATA)PDATA_Z,PDATA_I=_PDATA0_START-_PDATA0_END
-P(XDATA)PDATA_N=_PDATA0_START-_PDATA0_END
-Z(XDATA)PSTACK+_PDATA_STACK_SIZE=_PDATA0_START-_PDATA0_END
//
//    Stacks located in XDATA
//    -----------------------
-Z(XDATA)EXT_STACK+_EXTENDED_STACK_SIZE=_EXTENDED_STACK_START
-Z(XDATA)XSTACK+_XDATA_STACK_SIZE=_XDATA0_START-_XDATA0_END
//
//    XDATA - data memory
//    -------------------
-Z(XDATA)IXDATA_I,IXDATA_Z=_IXDATA0_START-_IXDATA0_END
-P(XDATA)IXDATA_N=_IXDATA0_START-_IXDATA0_END
-Z(XDATA)XDATA_I,XDATA_Z=_XDATA0_START-_XDATA0_END
-P(XDATA)XDATA_N=_XDATA0_START-_XDATA0_END
-Z(XDATA)XDATA_HEAP+_XDATA_HEAP_SIZE=_XDATA0_START-_XDATA0_END
-Z(CONST)XDATA_ROM_C=_XDATA0_START-_XDATA0_END
//
//    FAR22 - extended data memory
//    ----------------------------
-Z(XDATA)FAR22_I=[_FAR22_DATA0_START-_FAR22_DATA0_END]/10000
-Z(XDATA)FAR22_Z=[_FAR22_DATA0_START-_FAR22_DATA0_END]/10000
-Z(CODE)FAR22_ID=[_FAR22_CODE0_START-_FAR22_CODE0_END]/10000
-Z(XDATA)FAR22_HEAP+_FAR22_HEAP_SIZE=[_FAR22_DATA0_START-_FAR22_DATA0_END]/10000
-P(XDATA)FAR22_N=[_FAR22_DATA0_START-_FAR22_DATA0_END]/10000
-P(CONST)FAR22_ROM_C=[_FAR22_DATA0_START-_FAR22_DATA0_END]/10000
//
//    FAR - extended data memory
//    --------------------------
-Z(XDATA)FAR_I=[_FAR_DATA0_START-_FAR_DATA0_END]/10000
-Z(XDATA)FAR_Z=[_FAR_DATA0_START-_FAR_DATA0_END]/10000
-Z(CODE)FAR_ID=[_FAR_CODE0_START-_FAR_CODE0_END]/10000
-Z(XDATA)FAR_HEAP+_FAR_HEAP_SIZE=[_FAR_DATA0_START-_FAR_DATA0_END]/10000
-P(XDATA)FAR_N=[_FAR_DATA0_START-_FAR_DATA0_END]/10000
-P(CONST)FAR_ROM_C=[_FAR_DATA0_START-_FAR_DATA0_END]/10000
//
//    HUGE - extended data memory
//    ---------------------------
-Z(XDATA)HUGE_Z,HUGE_I=_FAR_DATA0_START-_FAR_DATA0_END
-P(XDATA)HUGE_N=_FAR_DATA0_START-_FAR_DATA0_END
-Z(XDATA)HUGE_HEAP+_HUGE_HEAP_SIZE=_FAR_DATA0_START-_FAR_DATA0_END
-Z(CONST)HUGE_ROM_C=_FAR_DATA0_START-_FAR_DATA0_END
//
//  Core
//  ====
-cx51
